## main/Kconfig.projbuild
```kconfig
menu "Environment Monitor Configuration"

config ENV_SLEEP_SECONDS
    int "Deep sleep duration (seconds)"
    range 1 86400
    default 10
    help
        Duration in seconds to sleep between AHT20 measurement cycles.
        Set to a small value (e.g. 10) for rapid testing, higher for production.

config ENV_MEASUREMENTS_PER_CYCLE
    int "Measurements per wake cycle"
    range 1 1000
    default 1
    help
        Number of AHT20 readings taken before entering deep sleep.

config ENV_ENABLE_LOGGING
    bool "Enable environment sensor logging"
    default y
    help
        Enable ESP_LOGI output for each measurement.

endmenu
```

## sdkconfig.defaults
```kconfig
# Custom ESP-IDF Configuration Defaults
# This file contains only the settings that differ from ESP-IDF defaults

# Flash Size - ESP32-C6FH4 has 4MB flash
CONFIG_ESPTOOLPY_FLASHSIZE_4MB=y

# Partition Table - Use large single app partition (3MB instead of 1MB)
CONFIG_PARTITION_TABLE_SINGLE_APP_LARGE=y

# Console Configuration - USB-Serial-JTAG as PRIMARY console (board has no USB-UART chip!)
CONFIG_ESP_CONSOLE_USB_SERIAL_JTAG=y
CONFIG_ESP_CONSOLE_SECONDARY_NONE=y
```
